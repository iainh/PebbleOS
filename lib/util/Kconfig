## lib/util/Kconfig
```kconfig
# SPDX-FileCopyrightText: 2026 Core Devices LLC
# SPDX-License-Identifier: Apache-2.0

config CRC32_RUST
    bool "Rust CRC-32 implementation"
    help
      Replace the C CRC-32 implementation with the Rust implementation.
```

## src/fw/Kconfig
```kconfig
# SPDX-FileCopyrightText: 2026 Core Devices LLC
# SPDX-License-Identifier: Apache-2.0

rsource "apps/Kconfig"
rsource "drivers/Kconfig"
rsource "kernel/Kconfig"
rsource "services/Kconfig"

menu "Software Features"

config BASE64_RUST
    bool "Rust Base64 implementation"
    help
      Replace the C Base64 implementation with the Rust implementation.

config COBS_RUST
    bool "Rust COBS implementation"
    help
      Replace the C COBS implementation with the Rust implementation.

config ANCS_UTIL_RUST
    bool "Rust ANCS attribute parser"
    help
      Replace the C ANCS attribute parser with the Rust implementation.

config KRAEPELIN_PIM_RUST
    bool "Rust Kraepelin PIM filter"
    help
      Replace the C Kraepelin PIM filter with the optimized Rust implementation.

config TINFLATE_RUST
    bool "Rust raw-DEFLATE decoder"
    help
      Replace tinflate with the bounded, buffered Rust implementation.

config BITBLT_PALETTE_RUST
    bool "Rust 1-bit palettized tiled blit"
    help
      Replace the per-pixel destination updates for 1-bit palettized tiled
      blits with a Rust implementation that updates each destination word once.

config GLYPH_RASTER_RUST
    bool "Rust 8-bit glyph rasterizer"
    depends on SCREEN_COLOR_DEPTH_BITS = 8
    help
      Use the optimized Rust row rasterizer for 1-bit font glyphs.

config ROTATED_BITMAP_RUST
    bool "Rust rotated bitmap rasterizer"
    help
      Replace the rotated bitmap pixel loop with the optimized Rust implementation.

config BITBLT_RUST
    bool "Rust 8-bit bitmap blitters"
    depends on SCREEN_COLOR_DEPTH_BITS = 8
    help
      Replace the tiled 8-bit and palettized bitmap hot paths with the
      optimized Rust implementation.

config SETTINGS_ICONS
    bool "Settings menu icons"
    help
      Show icons next to entries in the system Settings menu.

config THEMING
    bool "Color theming"
    help
      Expose the highlight-color theming UI under Settings.

config DYNAMIC_BACKLIGHT
    bool "Dynamic backlight"
    help
      Adjust backlight intensity based on ambient light readings.
      Requires an ambient light sensor.

config ACCEL_SENSITIVITY
    bool "Accelerometer sensitivity setting"
    help
      Expose the accelerometer tap/shake sensitivity adjustment in
      Settings.

config APP_SCALING
    bool "App scaling"
    help
      Scale legacy lower-resolution apps to the current display via
      the compositor.

config ORIENTATION_MANAGER
    bool "Orientation manager UI"
    help
      Expose the device-orientation / rotation prefs in shell and
      Settings. Independent of CONFIG_SERVICE_ORIENTATION_MANAGER,
      which controls whether the underlying service is built.

config MODDABLE_XS
    bool "Moddable XS JavaScript engine"
    help
      Build Moddable XS support for running JavaScript apps. PRF
      variant builds force this off regardless of the board default.

config MMAP_RESOURCES
    bool "Memory-mapped (zero-copy) resource reads"
    help
      Serve read-only system resources as direct pointers into
      memory-mapped flash instead of copying them out.

endmenu

choice
    prompt "Shell"
    default SHELL_NORMAL

config SHELL_NORMAL
    bool "Normal shell"

config SHELL_SDK
    bool "SDK shell"
    help
      Use the SDK shell instead of the normal shell.

endchoice

menu "Debug & instrumentation"

config NO_WATCH_TIMEOUT
    bool "Disable watchface idle timeout"

config NO_WATCHDOG
    bool "Disable watchdog reboots"
    help
      Do not reboot automatically when a watchdog fires; break into
      the debugger instead.

config UI_DEBUG
    bool "UI debug commands"
    help
      Enable the window dump and layer nudge CLI commands.

config PROMPT
    bool "Serial console prompt"
    default y
    help
      Build the serial console. Disable to save space.

config MALLOC_INSTRUMENTATION
    bool "Malloc instrumentation"
    help
      Track the caller PC of every heap allocation.

config PROFILER
    bool "Profiler"

config PROFILE_INTERRUPTS
    bool "Profile all interrupts"
    select PROFILER

config PERFORMANCE_TESTS
    bool "Performance test instrumentation"
    select PROFILER

endmenu
```

## src/fw/drivers/gpu/Kconfig
```kconfig
# SPDX-FileCopyrightText: 2026 Core Devices LLC
# SPDX-License-Identifier: Apache-2.0

config GPU_EPIC
    bool "SiFli EPIC graphics accelerator"
    depends on SOC_SF32LB52
    select HAL_SIFLI
    select HAL_SIFLI_EPIC
    select HAL_SIFLI_EZIP
    help
      Enable the SiFli ePicasso 2.0 graphics accelerator driver.

if GPU_EPIC

module = DRIVER_GPU_EPIC
module-str = EPIC GPU
source "subsys/logging/Kconfig.template.log_level"

endif
```

## src/fw/services/compositor/Kconfig
```kconfig
# SPDX-FileCopyrightText: 2026 Core Devices LLC
# SPDX-License-Identifier: Apache-2.0

config SERVICE_COMPOSITOR
    bool "Compositor"
    help
      UI compositor and window transitions.

config COMPOSITOR_LEGACY_SCALER_RUST
    bool "Rust legacy application scaler"
    depends on SERVICE_COMPOSITOR && APP_SCALING && SCREEN_COLOR_DEPTH_BITS = 8
    help
      Scale legacy ARGB2222 application framebuffer rows with the bounded
      Rust nearest-neighbour and bilinear kernel.

if SERVICE_COMPOSITOR

module = SERVICE_COMPOSITOR
module-str = Compositor
source "subsys/logging/Kconfig.template.log_level"

endif
```

## src/fw/services/filesystem/Kconfig
```kconfig
# SPDX-FileCopyrightText: 2026 Core Devices LLC
# SPDX-License-Identifier: Apache-2.0

config SERVICE_FILESYSTEM
    bool "Filesystem"
    help
      Pebble filesystem (PFS) service.

if SERVICE_FILESYSTEM

config PFS_RUST
    bool "Rust PFS implementation"
    select CRC32_RUST
    help
      Replace the C Pebble filesystem with the transactional Rust implementation.

module = SERVICE_FILESYSTEM
module-str = Filesystem
source "subsys/logging/Kconfig.template.log_level"

endif
```
